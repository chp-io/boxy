## examples/buildroot/Config.in
```kconfig
source "$BR2_EXTERNAL_vmilinux_PATH/package/libvmi/Config.in"
source "$BR2_EXTERNAL_vmilinux_PATH/package/vmilinux/Config.in"
```

## examples/buildroot/configs/vmilinux_defconfig
```kconfig
BR2_x86_64=y
BR2_x86_core2=y
BR2_TOOLCHAIN_BUILDROOT_GLIBC=y
BR2_PACKAGE_HOST_LINUX_HEADERS_CUSTOM_4_20=y
BR2_PACKAGE_GLIBC_UTILS=y
BR2_TOOLCHAIN_BUILDROOT_CXX=y
BR2_INIT_NONE=y
# BR2_TARGET_ENABLE_ROOT_LOGIN is not set
# BR2_TARGET_GENERIC_GETTY is not set
BR2_LINUX_KERNEL=y
BR2_LINUX_KERNEL_CUSTOM_TARBALL=y
BR2_LINUX_KERNEL_CUSTOM_TARBALL_LOCATION="https://github.com/Bareflank/linux/archive/boxy_1.01.tar.gz"
BR2_LINUX_KERNEL_USE_CUSTOM_CONFIG=y
BR2_LINUX_KERNEL_CUSTOM_CONFIG_FILE="${BR2_EXTERNAL_vmilinux_PATH}/../../bflinux/config"
# BR2_PACKAGE_BUSYBOX is not set
# BR2_PACKAGE_IFUPDOWN_SCRIPTS is not set
BR2_ROOTFS_POST_BUILD_SCRIPT="${BR2_EXTERNAL_vmilinux_PATH}/common/post-build.sh"
BR2_TARGET_ROOTFS_CPIO=y
BR2_TARGET_ROOTFS_CPIO_GZIP=y
# BR2_TARGET_ROOTFS_TAR is not set
BR2_PACKAGE_VMILINUX=y
```

## examples/buildroot/package/libvmi/Config.in
```kconfig
config BR2_PACKAGE_LIBVMI
	bool "libvmi"
	depends on BR2_TOOLCHAIN_USES_GLIBC
	depends on BR2_USE_WCHAR # glib2
	depends on BR2_TOOLCHAIN_HAS_THREADS # glib2
	depends on BR2_USE_MMU # glib2
	select BR2_PACKAGE_LIBGLIB2
	select BR2_PACKAGE_JSON_C
	# BR2_STATIC_LIBS
	help
	  LibVMI is a C library with Python bindings that makes it easy to monitor the
	  low-level details of a running virtual machine by viewing its memory, trapping
	  on hardware events, and accessing the vCPU registers. This is called virtual
	  machine introspection.

	  https://github.com/libvmi/libvmi
```

## examples/buildroot/package/vmilinux/Config.in
```kconfig
config BR2_PACKAGE_VMILINUX
    bool "vmilinux"
    depends on BR2_INSTALL_LIBSTDCPP
    select BR2_PACKAGE_LIBVMI
    help
      vmilinux starts a vmi app with populated cmdline parsed from the kernel's
      cmdline.
```
